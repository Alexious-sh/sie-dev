-carm
-Z(CODE)START,CODE,SWITAB,INITTAB,DATA_ID,DATA_C,CONFIG_DATA_ID=A0078000-A007D000

//0x20050
//A0074000

-Z(DATA)CONFIG_DATA_I,DATA_Z,DATA_I,DATA_N=A8D7ABF0-FFFFFFFF

-Z(CODE)PATCH_ONCREATE=A042E514-A042E517
-Z(CODE)PATCH_ONCLOSE=A042E528-A042E52B
-Z(CODE)PATCH_ESI1=A0906E4C-A0906E4F
-Z(CODE)PATCH_ESI2=A0906E5C-A0906E5F
-Z(CODE)PATCH_SHOWMSG_BLF=A065E4CC-A065E4CF
-Z(CODE)PATCH_NO_BROWSE_TXT=A054BE3A-A054BE3D

-Z(CODE)SWILIB_FUNC171=A00745C4-A00745C7
-Z(CODE)SWILIB_FUNC172=A00745C8-A00745CB
-Z(CODE)SWILIB_FUNC19C=A0074670-A0074673
-Z(CODE)SWILIB_FUNC1B8_1BB=A00746E0-A00746EF
-Z(CODE)SWILIB_FUNC1E9=A00747A4-A00747A7
-Z(CODE)SWILIB_FUNC2EE_2F5=A0074BB8-A0074BE8


-Z(CODE)PATCH_EXT2_R4R7=A04D46C2-A04D46C5     // +
-Z(CODE)PATCH_EXT2_R6R5=A04D47DC-A04D47DF    // +
-Z(CODE)PATCH_EXT2_R5R1=A04D452A-A04D452D     // +
-Z(CODE)PATCH_EXT2_R5R7=A04D442C-A04D442F     // +
-Z(CODE)PATCH_EXT2_CLUST1=A04D46EE-A04D46EF   // +
-Z(CODE)PATCH_EXT2_CLUST2=A04D444C-A04D444D   // +
-Z(CODE)PATCH_EXT2_JUMPERS=A04CEFB0-A04CEFD7  // +
-Z(CODE)PATCH_EXT2_IMPL=A04D470C-A04D4721     // +


-Z(CODE)PATCH_ENABLE_ALTOPEN=A05A0506-A05A0507

-Z(CODE)PATCH_GET_PIT=A0976188-A097618B       // +
-Z(CODE)PATCH_GET_PITJ=A097618C-A097618F     // +

-Z(CODE)FSWI_PATCH1=A13A5414-A13A5417
-Z(CODE)FSWI_PATCH2=A13A5328-A13A532B
-Z(CODE)LIBR=A0074000-A0077FFF
