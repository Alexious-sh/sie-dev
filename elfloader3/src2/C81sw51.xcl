//C81v51

-carm
-Z(CODE)START,CODE,SWITAB,INITTAB,DATA_ID,DATA_C,CONFIG_DATA_ID=A0078000-A007A000

-Z(DATA)CONFIG_DATA_I,DATA_N=A8DF9988-A8DFA2E7

-Z(CODE)PATCH_ONCREATE=A0439D4C-A0439D4F
-Z(CODE)PATCH_ONCLOSE=A0439D60-A0439D63
-Z(CODE)PATCH_ESI1=A0916534-A0916537
-Z(CODE)PATCH_ESI2=A0916544-A0916547
-Z(CODE)PATCH_SHOWMSG_BLF=A06728A4-A06728A7
-Z(CODE)PATCH_NO_BROWSE_TXT=A056ABEA-A056ABEB

-Z(CODE)SWILIB_FUNC171=A00745C4-A00745C7
-Z(CODE)SWILIB_FUNC172=A00745C8-A00745CB
-Z(CODE)SWILIB_FUNC19C=A0074670-A0074673
-Z(CODE)SWILIB_FUNC1B8_1BB=A00746E0-A00746EF
-Z(CODE)SWILIB_FUNC1E9=A00747A4-A00747A7

-Z(CODE)PATCH_EXT2_R4R7=A04E6F42-A04E6F45
-Z(CODE)PATCH_EXT2_R6R5=A04E705C-A04E705F
-Z(CODE)PATCH_EXT2_R5R1=A04E6DAA-A04E6DAD
-Z(CODE)PATCH_EXT2_R5R7=A04E6CAC-A04E6CAF
-Z(CODE)PATCH_EXT2_CLUST1=A04E6F6E-A04E6F6F
-Z(CODE)PATCH_EXT2_CLUST2=A04E6CCC-A04E6CCD
-Z(CODE)PATCH_EXT2_JUMPERS=A04DCB18-A04DCB3F
-Z(CODE)PATCH_EXT2_IMPL=A04E6F8C-A04E6FA1

-Z(CODE)PATCH_ENABLE_ALTOPEN=A05B6A2A-A05B6A2B

-Z(CODE)PATCH_GET_PIT=A096BA5C-A096BA5F
-Z(CODE)PATCH_GET_PITJ=A096BA60-A096BA63

-Z(CODE)FSWI_PATCH1=A1390A14-A1390A17	//000002A4+A13A10D0
-Z(CODE)FSWI_PATCH2=A1390928-A139092B	//000001B8+A13A10D0
-Z(CODE)LIBR=A0074000-A0077FFF
