-carm
-Z(CODE)START,CODE,SWITAB,INITTAB,DATA_ID,DATA_C,CONFIG_DATA_ID=A0FD8000-A0FDA000

-Z(DATA)CONFIG_DATA_I,DATA_N=A843F7AC-FFFFFFFF

-Z(CODE)PATCH_ONCREATE=A093F380-FFFFFFFF
-Z(CODE)PATCH_ONCLOSE=A093F384-FFFFFFFF
-Z(CODE)PATCH_ESI=A1567828-FFFFFFFF

-Z(CODE)PATCH_NO_UNK_EXT=A0956994-A0956997

-Z(CODE)SWILIB_FUNC00B=A0FD402C-A0FD402F
-Z(CODE)SWILIB_FUNC00C=A0FD4030-A0FD4033
-Z(CODE)SWILIB_FUNC095=A0FD4254-A0FD4257
-Z(CODE)SWILIB_FUNC12B_12D=A0FD44AC-A0FD44B7
-Z(CODE)SWILIB_FUNC171=A0FD45C4-A0FD45C7
-Z(CODE)SWILIB_FUNC172=A0FD45C8-A0FD45CB
-Z(CODE)SWILIB_FUNC19C=A0FD4670-A0FD4673
-Z(CODE)SWILIB_FUNC1B8_1BB=A0FD46E0-A0FD46EF
-Z(CODE)SWILIB_FUNC1E9=A0FD47A4-A0FD47A7


-Z(DATA)REGEXPL_CNT=A843F7A8-FFFFFFFF
-Z(CODE)REG_FILE=A0956F8C-FFFFFFFF

-Z(CODE)PATCH_GET_EXT=A0956964-FFFFFFFF
-Z(CODE)PATCH_GET_REGEXT1=A0956774-FFFFFFFF
-Z(CODE)PATCH_GET_REGEXT2=A0956788-FFFFFFFF
-Z(CODE)PATCH_BIG_ICON=A099FAF8-FFFFFFFF
-Z(CODE)PATCH_REGEXPL=A0957074-FFFFFFFF

-Z(CODE)PATCH_GET_PIT=A0CC9B84-FFFFFFFF
-Z(CODE)PATCH_GET_PITJ=A0CC9B88-FFFFFFFF

-Z(CODE)PATCH_KEYB_MSG=A0CBEA80-FFFFFFFF
-Z(CODE)PATCH_KEYB_MSGJ=A0CBEA84-FFFFFFFF

-Z(CODE)FSWI_PATCH1=A00929B0-A0092BE7	//000002A4+A13A10D0
-Z(CODE)FSWI_PATCH2=A0092A94-A0092CCB	//000001B8+A13A10D0
-Z(CODE)FSWI_PATCH3=A0092A93-A0092CC8
-Z(CODE)LIBR=A0FD4000-A0FD7FFF