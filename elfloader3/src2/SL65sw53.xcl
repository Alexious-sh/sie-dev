-carm
-Z(CODE)START,CODE,SWITAB,INITTAB,DATA_ID,DATA_C,CONFIG_DATA_ID=A0FD8000-A0FDA000

-Z(DATA)CONFIG_DATA_I,DATA_N=A8689128-A86898A4 

-Z(CODE)PATCH_ONCREATE=A1661B20-A1661B23
-Z(CODE)PATCH_ONCLOSE=A1661B24-A1661B27
-Z(CODE)PATCH_ESI=A13D74A4-A13D74AB

-Z(CODE)PATCH_NO_UNK_EXT=A092F050-A092F053

-Z(CODE)SWILIB_FUNC00B=A0FD402C-A0FD402F
-Z(CODE)SWILIB_FUNC00C=A0FD4030-A0FD4033

-Z(CODE)SWILIB_FUNC095=A0FD4254-A0FD4257
-Z(CODE)SWILIB_FUNC12B_12D=A0FD44AC-A0FD44B7
-Z(CODE)SWILIB_FUNC171=A0FD45C4-A0FD45C7
-Z(CODE)SWILIB_FUNC172=A0FD45C8-A0FD45CB
-Z(CODE)SWILIB_FUNC19C=A0FD4670-A0FD4673
-Z(CODE)SWILIB_FUNC1B8_1BB=A0FD46E0-A0FD46EF
-Z(CODE)SWILIB_FUNC1E9=A0FD47A4-A0FD47A7


-Z(DATA)REGEXPL_CNT=A8689124-A8689127
-Z(CODE)REG_FILE=A092F648-A092F69F

-Z(CODE)PATCH_GET_EXT=A092F020-A092F023
-Z(CODE)PATCH_GET_REGEXT1=A092EE30-A092EE33
-Z(CODE)PATCH_GET_REGEXT2=A092EE44-A092EE47
-Z(CODE)PATCH_BIG_ICON=A096A45C-A096A45F
-Z(CODE)PATCH_REGEXPL=A092F730-A092F733

-Z(CODE)PATCH_GET_PIT=A1151868-A115186B
-Z(CODE)PATCH_GET_PITJ=A115186C-A115186F


-Z(CODE)PATCH_KEYB_MSG=A1146F9C-A1146F9F
-Z(CODE)PATCH_KEYB_MSGJ=A1146FA0-A1146FA3

//-Z(CODE)FSWI_CODE=A0FD8000-A0FD80FF
-Z(CODE)FSWI_PATCH1=A00925E0-A00925E3 //A00929A4-A00929A7	//000002A4+A13A10D0
-Z(CODE)FSWI_PATCH2=A00926C4-A00926C7 //A0092A88-A0092A8B	//000001B8+A13A10D0
-Z(CODE)FSWI_PATCH3=A00926C3-A00926C4
-Z(CODE)LIBR=A0FD4000-A0FD7FFF

