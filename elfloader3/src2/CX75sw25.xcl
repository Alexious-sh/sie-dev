-carm
-Z(CODE)START,CODE,SWITAB,INITTAB,DATA_ID,DATA_C,CONFIG_DATA_ID=A0FD8000-A0FDA000

-Z(DATA)CONFIG_DATA_I,DATA_N=A84C81D4-FFFFFFFF

-Z(CODE)PATCH_ONCREATE=A04A3808-FFFFFFFF
-Z(CODE)PATCH_ONCLOSE=A04A380C-FFFFFFFF
-Z(CODE)PATCH_ESI=A0A85B48-FFFFFFFF

-Z(CODE)PATCH_NO_UNK_EXT=A02A0984-A02A0987

-Z(CODE)SWILIB_FUNC00B=A0FD402C-A0FD402F
-Z(CODE)SWILIB_FUNC00C=A0FD4030-A0FD4033
-Z(CODE)SWILIB_FUNC095=A0FD4254-A0FD4257
-Z(CODE)SWILIB_FUNC12B_12D=A0FD44AC-A0FD44B7
-Z(CODE)SWILIB_FUNC171=A0FD45C4-A0FD45C7
-Z(CODE)SWILIB_FUNC172=A0FD45C8-A0FD45CB
-Z(CODE)SWILIB_FUNC19C=A0FD4670-A0FD4673
-Z(CODE)SWILIB_FUNC1B8_1BB=A0FD46E0-A0FD46EF
-Z(CODE)SWILIB_FUNC1E9=A0FD47A4-A0FD47A7

-Z(DATA)REGEXPL_CNT=A84C81D0-FFFFFFFF
-Z(CODE)REG_FILE=A02A0F7C-FFFFFFFF

-Z(CODE)PATCH_GET_EXT=A02A0954-FFFFFFFF
-Z(CODE)PATCH_GET_REGEXT1=A02A0764-FFFFFFFF
-Z(CODE)PATCH_GET_REGEXT2=A02A0778-FFFFFFFF
-Z(CODE)PATCH_BIG_ICON=A0354FE4-FFFFFFFF
-Z(CODE)PATCH_REGEXPL=A02A1064-FFFFFFFF

-Z(CODE)PATCH_GET_PIT=A0801A60-A0801A63
-Z(CODE)PATCH_GET_PITJ=A0801A64-A0801A68

-Z(CODE)PATCH_KEYB_MSG=A07F6974-FFFFFFFF
-Z(CODE)PATCH_KEYB_MSGJ=A07F6978-FFFFFFFF

-Z(CODE)FSWI_PATCH1=A0092BE4-FFFFFFFF
-Z(CODE)FSWI_PATCH2=A0092CC8-FFFFFFFF
-Z(CODE)FSWI_PATCH3=A0092CC7-FFFFFFFF
-Z(CODE)LIBR=A0FD4000-A0FD7FFF