//CL61v00 (p)Dimadze, (f)Marie

-carm
-Z(CODE)START,CODE,SWITAB,INITTAB,DATA_ID,DATA_C,CONFIG_DATA_ID=A1324000-A1329000


-Z(DATA)CONFIG_DATA_I,DATA_Z,DATA_N=A8D9DBD8-FFFFFFFF

-Z(CODE)PATCH_ONCREATE=A0E31A84-FFFFFFFF
-Z(CODE)PATCH_ONCLOSE=A0E31A98-FFFFFFFF


-Z(CODE)PATCH_ESI1=A0A92164-FFFFFFFF
-Z(CODE)PATCH_ESI2=A0A92174-FFFFFFFF

-Z(CODE)PATCH_SHOWMSG_BLF=A0398F9C-FFFFFFFF
-Z(CODE)PATCH_NO_BROWSE_TXT=A052093E-FFFFFFFF

-Z(CODE)SWILIB_FUNC171=A13205C4-A13205C7
-Z(CODE)SWILIB_FUNC172=A13205C8-A13205CB
-Z(CODE)SWILIB_FUNC19C=A1320670-A1320673
-Z(CODE)SWILIB_FUNC1B8_1BB=A13206E0-A13206EF
-Z(CODE)SWILIB_FUNC1E9=A13207A4-A13207A7
-Z(CODE)SWILIB_FUNC2EE_2F5=A1320BB8-A1320BE8

-Z(DATA)REGEXPL_CNT=A8D9DBD4-A8D9DBD7

-Z(CODE)PATCH_EXT2_R7=A00C03EC-FFFFFFFF
-Z(CODE)PATCH_EXT2_R6=A00C05D0-FFFFFFFF
-Z(CODE)PATCH_EXT2_R7_1=A00C0020-FFFFFFFF
-Z(CODE)PATCH_EXT2_R2=A00C01A4-FFFFFFFF

-Z(CODE)PATCH_EXT2_IMPL=A00C0470-FFFFFFFF

-Z(CODE)PATCH_ENABLE_ALTOPEN=A0860568-FFFFFFFF

-Z(CODE)PATCH_GET_PIT=A046B64A-FFFFFFFF
-Z(CODE)PATCH_GET_PITJ=A046B650-FFFFFFFF

-Z(CODE)FSWI_PATCH1=A12FC444-FFFFFFFF
-Z(CODE)FSWI_PATCH2=A12FC358-FFFFFFFF
-Z(CODE)LIBR=A1320000-A1323FFF
