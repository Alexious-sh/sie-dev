-carm
-Z(CODE)START,CODE,SWITAB,INITTAB,DATA_ID,DATA_C,CONFIG_DATA_ID=A0FD8000-A0FDA000

-Z(DATA)CONFIG_DATA_I,DATA_N=A86894C0-A8689C3C

-Z(CODE)PATCH_ONCREATE=A1734898-A173489B
-Z(CODE)PATCH_ONCLOSE=A173489C-A173489F
-Z(CODE)PATCH_ESI=A1559B44-A1559B4B

-Z(CODE)PATCH_NO_UNK_EXT=A0951F64-A0951F67

-Z(CODE)SWILIB_FUNC00B=A0FD402C-A0FD402F
-Z(CODE)SWILIB_FUNC00C=A0FD4030-A0FD4033
-Z(CODE)SWILIB_FUNC095=A0FD4254-A0FD4257
-Z(CODE)SWILIB_FUNC12B_12D=A0FD44AC-A0FD44B7
-Z(CODE)SWILIB_FUNC171=A0FD45C4-A0FD45C7
-Z(CODE)SWILIB_FUNC172=A0FD45C8-A0FD45CB
-Z(CODE)SWILIB_FUNC19C=A0FD4670-A0FD4673
-Z(CODE)SWILIB_FUNC1B8_1BB=A0FD46E0-A0FD46EF
-Z(CODE)SWILIB_FUNC1E9=A0FD47A4-A0FD47A7

-Z(DATA)REGEXPL_CNT=A86894BC-A86894BF
-Z(CODE)REG_FILE=A095255C-A09525B3

-Z(CODE)PATCH_GET_EXT=A0951F34-A0951F37
-Z(CODE)PATCH_GET_REGEXT1=A0951D44-A0951D47
-Z(CODE)PATCH_GET_REGEXT2=A0951D58-A0951D5B
-Z(CODE)PATCH_BIG_ICON=A0990D28-A0990D2B
-Z(CODE)PATCH_REGEXPL=A0952644-A0952647

-Z(CODE)PATCH_GET_PIT=A0CB75B4-A0CB75B7
-Z(CODE)PATCH_GET_PITJ=A0CB75B8-A0CB75BB

-Z(CODE)PATCH_KEYB_MSG=A0CACCF8-A0CACCFB
-Z(CODE)PATCH_KEYB_MSGJ=A0CACCFC-A0CACCFF

-Z(CODE)FSWI_PATCH1=A00929A4-A00929A7	//000002A4+A13A10D0
-Z(CODE)FSWI_PATCH2=A0092A88-A0092A8B	//000001B8+A13A10D0
-Z(CODE)FSWI_PATCH3=A0092A87-A0092A88
-Z(CODE)LIBR=A0FD4000-A0FD7FFF