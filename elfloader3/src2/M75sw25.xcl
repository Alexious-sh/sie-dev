-carm
-Z(CODE)START,CODE,SWITAB,INITTAB,DATA_ID,DATA_C,CONFIG_DATA_ID=A0FD8000-A0FDA000

-Z(DATA)CONFIG_DATA_I,DATA_N=A84C812C-A84C88A8

-Z(CODE)PATCH_ONCREATE=A04A36F0-A04A36F3
-Z(CODE)PATCH_ONCLOSE=A04A36F4-A04A36F7
-Z(CODE)PATCH_ESI=A0A84758-A0A8475F

-Z(CODE)PATCH_NO_UNK_EXT=A02A0984-A02A0987

-Z(CODE)SWILIB_FUNC00B=A0FD402C-A0FD402F
-Z(CODE)SWILIB_FUNC00C=A0FD4030-A0FD4033
-Z(CODE)SWILIB_FUNC095=A0FD4254-A0FD4257
-Z(CODE)SWILIB_FUNC12B_12D=A0FD44AC-A0FD44B7
-Z(CODE)SWILIB_FUNC171=A0FD45C4-A0FD45C7
-Z(CODE)SWILIB_FUNC172=A0FD45C8-A0FD45CB
-Z(CODE)SWILIB_FUNC19C=A0FD4670-A0FD4673
-Z(CODE)SWILIB_FUNC1B8_1BB=A0FD46E0-A0FD46EF
-Z(CODE)SWILIB_FUNC1E9=A0FD47A4-A0FD47A7

-Z(DATA)REGEXPL_CNT=A84C8128-A84C812B
-Z(CODE)REG_FILE=A02A0F7C-A02A0FD3

-Z(CODE)PATCH_GET_EXT=A02A0954-A02A0957
-Z(CODE)PATCH_GET_REGEXT1=A02A0764-A02A0767
-Z(CODE)PATCH_GET_REGEXT2=A02A0778-A02A077B
-Z(CODE)PATCH_BIG_ICON=A0354FE8-A0354FEB
-Z(CODE)PATCH_REGEXPL=A02A1064-A02A1067

-Z(CODE)PATCH_GET_PIT=A0800EEC-A0800EEF
-Z(CODE)PATCH_GET_PITJ=A0800EF0-A0800EF3

-Z(CODE)PATCH_KEYB_MSG=A07F5E00-A07F5E03
-Z(CODE)PATCH_KEYB_MSGJ=A07F5E04-A07F5E07

-Z(CODE)FSWI_PATCH1=A0092BE0-A0092BE3	//000002A4+A13A10D0
-Z(CODE)FSWI_PATCH2=A0092CC4-A0092CC7	//000001B8+A13A10D0
-Z(CODE)FSWI_PATCH3=A0092CC3-A0092CC4
-Z(CODE)LIBR=A0FD4000-A0FD7FFF