-carm
-Z(CODE)START,CODE,SWITAB,INITTAB,DATA_ID,DATA_C,CONFIG_DATA_ID=A0078000-A007A000

-Z(DATA)CONFIG_DATA_I,DATA_N=A8D9F004-A8D9F963

-Z(CODE)PATCH_ONCREATE=A0851A6C-A0851A6F
-Z(CODE)PATCH_ONCLOSE=A0851A80-A0851A83


-Z(CODE)PATCH_ESI1=A08DCC28-A08DCC2B
-Z(CODE)PATCH_ESI2=A08DCC38-A08DCC3B

-Z(CODE)PATCH_SHOWMSG_BLF=A07FCCF8-A07FCCFB
-Z(CODE)PATCH_NO_BROWSE_TXT=A06CAD5A-A06CAD5B

-Z(CODE)SWILIB_FUNC171=A00745C4-A00745C7
-Z(CODE)SWILIB_FUNC172=A00745C8-A00745CB
-Z(CODE)SWILIB_FUNC19C=A0074670-A0074673
-Z(CODE)SWILIB_FUNC1B8_1BB=A00746E0-A00746EF
-Z(CODE)SWILIB_FUNC1E9=A00747A4-A00747A7

-Z(DATA)REGEXPL_CNT=A8D9F000-A8D9F003

-Z(CODE)PATCH_EXT2_R7=A0507388-A050738B
-Z(CODE)PATCH_EXT2_R6=A050756C-A050756F
-Z(CODE)PATCH_EXT2_R7_1=A0506FBC-A0506FBF
-Z(CODE)PATCH_EXT2_R2=A0507140-A0507143

-Z(CODE)PATCH_EXT2_IMPL=A050740C-A050742F

-Z(CODE)PATCH_ENABLE_ALTOPEN=A0728880-A0728883

-Z(CODE)PATCH_GET_PIT=A0953932-A0953935
-Z(CODE)PATCH_GET_PITJ=A0953938-A095393B

-Z(CODE)FSWI_PATCH1=A12DA780-A12DA783	//000002A4+A13A10D0
-Z(CODE)FSWI_PATCH2=A12DA694-A12DA697	//000001B8+A13A10D0
-Z(CODE)LIBR=A0074000-A0077FFF
