//CL61v00 db128 (p)Evgr, (f)Marie

-carm
-Z(CODE)START,CODE,SWITAB,INITTAB,DATA_ID,DATA_C,CONFIG_DATA_ID=A1324000-A1329000


-Z(DATA)CONFIG_DATA_I,DATA_Z,DATA_N=A8D9DD54-FFFFFFFF
                                                                                                                                                                            
-Z(CODE)PATCH_ONCREATE=A0E4828C-FFFFFFFF
-Z(CODE)PATCH_ONCLOSE=A0E482A0-FFFFFFFF 
                                                                                                                                                                      

-Z(CODE)PATCH_ESI1=A075B260-FFFFFFFF
-Z(CODE)PATCH_ESI2=A075B270-FFFFFFFF

-Z(CODE)PATCH_SHOWMSG_BLF=A0A35598-FFFFFFFF
-Z(CODE)PATCH_NO_BROWSE_TXT=A016E106-FFFFFFFF

-Z(CODE)SWILIB_FUNC171=A13205C4-A13205C7
-Z(CODE)SWILIB_FUNC172=A13205C8-A13205CB
-Z(CODE)SWILIB_FUNC19C=A1320670-A1320673
-Z(CODE)SWILIB_FUNC1B8_1BB=A13206E0-A13206EF
-Z(CODE)SWILIB_FUNC1E9=A13207A4-A13207A7
-Z(CODE)SWILIB_FUNC2EE=A1320BB8-A1320C0C

-Z(DATA)REGEXPL_CNT=A8D9DD50-A8D9DD53

-Z(CODE)PATCH_EXT2_R7=A074721C-FFFFFFFF
-Z(CODE)PATCH_EXT2_R6=A0747400-FFFFFFFF
-Z(CODE)PATCH_EXT2_R7_1=A0746E50-FFFFFFFF
-Z(CODE)PATCH_EXT2_R2=A0746FD4-FFFFFFFF

-Z(CODE)PATCH_EXT2_IMPL=A07472A0-FFFFFFFF

-Z(CODE)PATCH_ENABLE_ALTOPEN=A053D4E4-FFFFFFFF

-Z(CODE)PATCH_GET_PIT=A047E7FE-FFFFFFFF
-Z(CODE)PATCH_GET_PITJ=A047E804-FFFFFFFF

-Z(CODE)FSWI_PATCH1=A12FF8C8-FFFFFFFF
-Z(CODE)FSWI_PATCH2=A12FF7DC-FFFFFFFF
-Z(CODE)LIBR=A1320000-A1323FFF
