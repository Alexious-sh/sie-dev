-carm
-Z(CODE)START,CODE,SWITAB,INITTAB,DATA_ID,DATA_C,CONFIG_DATA_ID=A0FD8000-A0FDA000

-Z(DATA)CONFIG_DATA_I,DATA_N=A84C8194-FFFFFFFF

-Z(CODE)PATCH_ONCREATE=A04A3314-FFFFFFFF
-Z(CODE)PATCH_ONCLOSE=A04A3318-FFFFFFFF
-Z(CODE)PATCH_ESI=A0A81EA0-FFFFFFFF

-Z(CODE)PATCH_NO_UNK_EXT=A02A089C-A02A089F

-Z(CODE)SWILIB_FUNC00B=A0FD402C-A0FD402F
-Z(CODE)SWILIB_FUNC00C=A0FD4030-A0FD4033
-Z(CODE)SWILIB_FUNC095=A0FD4254-A0FD4257
-Z(CODE)SWILIB_FUNC12B_12D=A0FD44AC-A0FD44B7
-Z(CODE)SWILIB_FUNC171=A0FD45C4-A0FD45C7
-Z(CODE)SWILIB_FUNC172=A0FD45C8-A0FD45CB
-Z(CODE)SWILIB_FUNC19C=A0FD4670-A0FD4673
-Z(CODE)SWILIB_FUNC1B8_1BB=A0FD46E0-A0FD46EF
-Z(CODE)SWILIB_FUNC1E9=A0FD47A4-A0FD47A7

-Z(DATA)REGEXPL_CNT=A84C8190-FFFFFFFF
-Z(CODE)REG_FILE=A02A0E94-FFFFFFFF

-Z(CODE)PATCH_GET_EXT=A02A086C-FFFFFFFF
-Z(CODE)PATCH_GET_REGEXT1=A02A067C-FFFFFFFF
-Z(CODE)PATCH_GET_REGEXT2=A02A0690-FFFFFFFF
-Z(CODE)PATCH_BIG_ICON=A03545DC-FFFFFFFF
-Z(CODE)PATCH_REGEXPL=A02A0F7C-FFFFFFFF

-Z(CODE)PATCH_GET_PIT=A07FF29C-FFFFFFFF
-Z(CODE)PATCH_GET_PITJ=A07FF2A0-FFFFFFFF

-Z(CODE)PATCH_KEYB_MSG=A07F41F4-FFFFFFFF
-Z(CODE)PATCH_KEYB_MSGJ=A07F41F8-FFFFFFFF

-Z(CODE)FSWI_PATCH1=A0092BE4-FFFFFFFF
-Z(CODE)FSWI_PATCH2=A0092CC8-FFFFFFFF
-Z(CODE)FSWI_PATCH3=A0092CC7-FFFFFFFF
-Z(CODE)LIBR=A0FD4000-A0FD7FFF