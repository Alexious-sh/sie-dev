-carm
-Z(CODE)START,CODE,SWITAB,INITTAB,DATA_ID,DATA_C,CONFIG_DATA_ID=A0078000-A007A000

-Z(DATA)CONFIG_DATA_I,DATA_N=A8D75AB8-A8D76417

-Z(CODE)PATCH_ONCREATE=A03F75CC-A03F75CF
-Z(CODE)PATCH_ONCLOSE=A03F75E0-A03F75E3
-Z(CODE)PATCH_ESI1=A07A93E0-A07A93E3
-Z(CODE)PATCH_ESI2=A07A93F0-A07A93F3
-Z(CODE)PATCH_SHOWMSG_BLF=A0518810-A0518813
-Z(CODE)PATCH_NO_BROWSE_TXT=A0464E76-A0464E77

-Z(CODE)SWILIB_FUNC171=A00745C4-A00745C7
-Z(CODE)SWILIB_FUNC172=A00745C8-A00745CB
-Z(CODE)SWILIB_FUNC19C=A0074670-A0074673
-Z(CODE)SWILIB_FUNC1B8_1BB=A00746E0-A00746EF
-Z(CODE)SWILIB_FUNC1E9=A00747A4-A00747A7

-Z(CODE)PATCH_EXT2_R4R7=A026EFC6-A026EFC9
-Z(CODE)PATCH_EXT2_R6R5=A026F0E0-A026F0E3
-Z(CODE)PATCH_EXT2_R5R1=A026EE2E-A026EE31
-Z(CODE)PATCH_EXT2_R5R7=A026ED30-A026ED33
-Z(CODE)PATCH_EXT2_CLUST1=A026EFF2-A026EFF3
-Z(CODE)PATCH_EXT2_CLUST2=A026ED50-A026ED51
-Z(CODE)PATCH_EXT2_JUMPERS=A01C0CD8-A01C0CFF
-Z(CODE)PATCH_EXT2_IMPL=A026F010-A026F025

-Z(CODE)PATCH_ENABLE_ALTOPEN=A033D3BE-A033D3BF

-Z(CODE)PATCH_GET_PIT=A07FB3C0-A07FB3C3
-Z(CODE)PATCH_GET_PITJ=A07FB3C4-A07FB3C7

-Z(CODE)FSWI_PATCH1=A10794A4-A10794A7
-Z(CODE)FSWI_PATCH2=A10793B8-A10793BB
-Z(CODE)LIBR=A0074000-A0077FFF
