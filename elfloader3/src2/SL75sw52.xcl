-carm
// SL75v52!!!  (p) kiREALlov

-Z(CODE)START,CODE,SWITAB,INITTAB,DATA_ID,DATA_C,CONFIG_DATA_ID=A0078000-A007A000

-Z(DATA)CONFIG_DATA_I,DATA_N=A8D7ABFC-A8D7B55B

-Z(CODE)PATCH_ONCREATE=A0432AB8-A0432ABB
-Z(CODE)PATCH_ONCLOSE=A0432ACC-A0432ACF
-Z(CODE)PATCH_ESI1=A0908CFC-A0908CFF
-Z(CODE)PATCH_ESI2=A0908D0C-A0908D0F
-Z(CODE)PATCH_SHOWMSG_BLF=A066124C-A066124F
-Z(CODE)PATCH_NO_BROWSE_TXT=A0552E62-A0552E67

-Z(CODE)SWILIB_FUNC171=A00745C4-A00745C7
-Z(CODE)SWILIB_FUNC172=A00745C8-A00745CB
-Z(CODE)SWILIB_FUNC19C=A0074670-A0074673
-Z(CODE)SWILIB_FUNC1B8_1BB=A00746E0-A00746EF
-Z(CODE)SWILIB_FUNC1E9=A00747A4-A00747A7

-Z(CODE)PATCH_EXT2_R4R7=A04D9F8A-A04D9F8F    // +
-Z(CODE)PATCH_EXT2_R6R5=A04DA0A4-A04DA0A7     // +
-Z(CODE)PATCH_EXT2_R5R1=A04D9DF2-A04D9DF5     // +
-Z(CODE)PATCH_EXT2_R5R7=A04D9CF4-A04D9CF7    // +
-Z(CODE)PATCH_EXT2_CLUST1=A04D9FB6-A04D9FB7   // +
-Z(CODE)PATCH_EXT2_CLUST2=A04D9D14-A04D9D15   // +
-Z(CODE)PATCH_EXT2_JUMPERS=A04D3E28-A04D3E4F  // +
-Z(CODE)PATCH_EXT2_IMPL=A04D9FD4-A04D9FE9    //+


-Z(CODE)PATCH_ENABLE_ALTOPEN=A05A35A2-A05A35A3

-Z(CODE)PATCH_GET_PIT=A0978B88-A0978B8B      // +
-Z(CODE)PATCH_GET_PITJ=A0978B8C-A0978B8F      // +

-Z(CODE)FSWI_PATCH1=A13A3694-A13A3697
-Z(CODE)FSWI_PATCH2=A13A35A8-A13A35AB
-Z(CODE)LIBR=A0074000-A0077FFF