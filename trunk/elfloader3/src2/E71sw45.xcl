-carm
-Z(CODE)START,CODE,SWITAB,INITTAB,DATA_ID,DATA_C,CONFIG_DATA_ID=A0078000-A007A000

-Z(DATA)CONFIG_DATA_I,DATA_N=A8D9F178-A8D9FAD7

-Z(CODE)PATCH_ONCREATE=A084B698-A084B69B
-Z(CODE)PATCH_ONCLOSE=A084B6AC-A084B6AF


-Z(CODE)PATCH_ESI1=A08D5FF4-A08D5FF7
-Z(CODE)PATCH_ESI2=A08D6004-A08D6007

-Z(CODE)PATCH_SHOWMSG_BLF=A07F9600-A07F9603
-Z(CODE)PATCH_NO_BROWSE_TXT=A06C697A-A06C697D

-Z(CODE)SWILIB_FUNC171=A00745C4-A00745C7
-Z(CODE)SWILIB_FUNC172=A00745C8-A00745CB
-Z(CODE)SWILIB_FUNC19C=A0074670-A0074673
-Z(CODE)SWILIB_FUNC1B8_1BB=A00746E0-A00746EF
-Z(CODE)SWILIB_FUNC1E9=A00747A4-A00747A7

-Z(DATA)REGEXPL_CNT=A8D9F174-A8D9F177

-Z(CODE)PATCH_EXT2_R7=A0502A78-A0502A7B
-Z(CODE)PATCH_EXT2_R6=A0502C5C-A0502C5F
-Z(CODE)PATCH_EXT2_R7_1=A05026AC-A05026AF
-Z(CODE)PATCH_EXT2_R2=A0502830-A0502833

-Z(CODE)PATCH_EXT2_IMPL=A0502AFC-A0502B1F

-Z(CODE)PATCH_ENABLE_ALTOPEN=A071CDD4-A071CDD7

-Z(CODE)PATCH_GET_PIT=A094CE9A-A094CE9D
-Z(CODE)PATCH_GET_PITJ=A094CEA0-A094CEA3

-Z(CODE)FSWI_PATCH1=A12D1414-A12D1417  //000002A4+A13A10D0
-Z(CODE)FSWI_PATCH2=A12D1328-A12D132B  //000001B8+A13A10D0
-Z(CODE)LIBR=A0074000-A0077FFF