//M81v51

-carm
-Z(CODE)START,CODE,SWITAB,INITTAB,DATA_ID,DATA_C,CONFIG_DATA_ID=A0078000-A007A000

-Z(DATA)CONFIG_DATA_I,DATA_N=A8DF9988-A8DFA2E7

-Z(CODE)PATCH_ONCREATE=A0439D70-A0439D73
-Z(CODE)PATCH_ONCLOSE=A0439D84-A0439D87
-Z(CODE)PATCH_ESI1=A0916558-A091655B
-Z(CODE)PATCH_ESI2=A0916568-A091656B
-Z(CODE)PATCH_SHOWMSG_BLF=A06728C8-A06728CB
-Z(CODE)PATCH_NO_BROWSE_TXT=A056AC0E-A056AC0F

-Z(CODE)SWILIB_FUNC171=A00745C4-A00745C7
-Z(CODE)SWILIB_FUNC172=A00745C8-A00745CB
-Z(CODE)SWILIB_FUNC19C=A0074670-A0074673
-Z(CODE)SWILIB_FUNC1B8_1BB=A00746E0-A00746EF
-Z(CODE)SWILIB_FUNC1E9=A00747A4-A00747A7

-Z(CODE)PATCH_EXT2_R4R7=A04E6F66-A04E6F69
-Z(CODE)PATCH_EXT2_R6R5=A04E7080-A04E7083
-Z(CODE)PATCH_EXT2_R5R1=A04E6DCE-A04E6DD1
-Z(CODE)PATCH_EXT2_R5R7=A04E6CD0-A04E6CD3
-Z(CODE)PATCH_EXT2_CLUST1=A04E6F92-A04E6F93
-Z(CODE)PATCH_EXT2_CLUST2=A04E6CF0-A04E6CF1
-Z(CODE)PATCH_EXT2_JUMPERS=A04DCB3C-A04DCB63
-Z(CODE)PATCH_EXT2_IMPL=A04E6FB0-A04E6FC5

-Z(CODE)PATCH_ENABLE_ALTOPEN=A05B6A4E-A05B6A4F

-Z(CODE)PATCH_GET_PIT=A096BA80-A096BA83
-Z(CODE)PATCH_GET_PITJ=A096BA84-A096BA87

-Z(CODE)FSWI_PATCH1=A1390A38-A1390A3B	//000002A4+A13A10D0
-Z(CODE)FSWI_PATCH2=A139094C-A139094F	//000001B8+A13A10D0
-Z(CODE)LIBR=A0074000-A0077FFF
