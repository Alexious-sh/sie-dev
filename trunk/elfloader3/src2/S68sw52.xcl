//(p) Hotter
-carm
-Z(CODE)START,CODE,SWITAB,INITTAB,DATA_ID,DATA_C,CONFIG_DATA_ID=A0078000-A007D000     //+

-Z(DATA)CONFIG_DATA_I,DATA_Z,DATA_N=A8D75AD4-A8D76433     //+???

-Z(CODE)PATCH_ONCREATE=A03F79A4-A03F79A7      //+???
-Z(CODE)PATCH_ONCLOSE=A03F79B8-A03F79BB       //+???
-Z(CODE)PATCH_ESI1=A07A9C1C-A07A9C1F          //+???
-Z(CODE)PATCH_ESI2=A07A9C2C-A07A9C2F          //+???
-Z(CODE)PATCH_SHOWMSG_BLF=A0519074-A0519077   //+???
-Z(CODE)PATCH_NO_BROWSE_TXT=A04652EA-A04652ED //+???  //or // A04652EA-A04652EB

-Z(CODE)SWILIB_FUNC171=A00745C4-A00745C7   //+
-Z(CODE)SWILIB_FUNC172=A00745C8-A00745CB    //+
-Z(CODE)SWILIB_FUNC19C=A0074670-A0074673       //+
-Z(CODE)SWILIB_FUNC1B8_1BB=A00746E0-A00746EF    //+
-Z(CODE)SWILIB_FUNC1E9=A00747A4-A00747A7       //+
-Z(CODE)SWILIB_FUNC2EE=A0074BB8-A0074C0C   //+

-Z(CODE)PATCH_EXT2_R4R7=A026F2FA-A026F2FD     //+???
-Z(CODE)PATCH_EXT2_R6R5=A026F414-A026F417     //+???
-Z(CODE)PATCH_EXT2_R5R1=A026F162-A026F165     //+???
-Z(CODE)PATCH_EXT2_R5R7=A026F064-A026F067     //+???
-Z(CODE)PATCH_EXT2_CLUST1=A026F326-A026F327   //+???
-Z(CODE)PATCH_EXT2_CLUST2=A026F084-A026F085   //+???
-Z(CODE)PATCH_EXT2_JUMPERS=A01C0EB4-A01C0EDB  //+???
-Z(CODE)PATCH_EXT2_IMPL=A026F344-A026F359     //+???

-Z(CODE)PATCH_ENABLE_ALTOPEN=A033DB6E-A033DB6F  //+???

-Z(CODE)PATCH_GET_PIT=A07FBBFC-A07FBBFF         //+???
-Z(CODE)PATCH_GET_PITJ=A07FBC00-A07FBC03        //+???

-Z(CODE)FSWI_PATCH1=A1079DB4-A1079DB7           //+???
-Z(CODE)FSWI_PATCH2=A1079CC8-A1079CCB           //+???
-Z(CODE)LIBR=A0074000-A0077FFF           //+