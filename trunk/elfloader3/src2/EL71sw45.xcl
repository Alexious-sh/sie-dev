//EL71v45

-carm
-Z(CODE)START,CODE,SWITAB,INITTAB,DATA_ID,DATA_C,CONFIG_DATA_ID=A0078000-A007A000

-Z(DATA)CONFIG_DATA_I,DATA_N=A8D9F004-A8D9F963

-Z(CODE)PATCH_ONCREATE=A0853F98-A0853F9B
-Z(CODE)PATCH_ONCLOSE=A0853FAC-A0853FAF


-Z(CODE)PATCH_ESI1=A08DF41C-A08DF41F
-Z(CODE)PATCH_ESI2=A08DF42C-A08DF42F

-Z(CODE)PATCH_SHOWMSG_BLF=A07FF180-A07FF184
-Z(CODE)PATCH_NO_BROWSE_TXT=A06Cc03A-A06Cc03B

-Z(CODE)SWILIB_FUNC171=A00745C4-A00745C7
-Z(CODE)SWILIB_FUNC172=A00745C8-A00745CB
-Z(CODE)SWILIB_FUNC19C=A0074670-A0074673
-Z(CODE)SWILIB_FUNC1B8_1BB=A00746E0-A00746EF
-Z(CODE)SWILIB_FUNC1E9=A00747A4-A00747A7

-Z(DATA)REGEXPL_CNT=A8D9F000-A8D9F003

-Z(CODE)PATCH_EXT2_R7=A0508220-A0508223
-Z(CODE)PATCH_EXT2_R6=A0508404-A0508407
-Z(CODE)PATCH_EXT2_R7_1=A0507E54-A0507E57
-Z(CODE)PATCH_EXT2_R2=A0507FD8-A0507FDB

-Z(CODE)PATCH_EXT2_IMPL=A05082A4-A05082C7

-Z(CODE)PATCH_ENABLE_ALTOPEN=A072A414-A072A417

-Z(CODE)PATCH_GET_PIT=A0956C1E-A0956C21
-Z(CODE)PATCH_GET_PITJ=A0956C24-A0956C27

-Z(CODE)FSWI_PATCH1=A12DD85C-A12DD85F	//000002A4+A13A10D0
-Z(CODE)FSWI_PATCH2=A12DD770-A12DD773	//000001B8+A13A10D0
-Z(CODE)LIBR=A0074000-A0077FFF
