-carm
-Z(CODE)START,CODE,SWITAB,INITTAB,DATA_ID,DATA_C,CONFIG_DATA_ID=A10E8000-A10EA000

-Z(DATA)CONFIG_DATA_I,DATA_N=A84BCC8C-A84BD408

-Z(CODE)PATCH_ONCREATE=A0491D68-A0491D6B
-Z(CODE)PATCH_ONCLOSE=A0491D6C-A0491D6F
-Z(CODE)PATCH_ESI=A0A148D0-A0A148D7

-Z(CODE)PATCH_NO_UNK_EXT=A02A0874-A02A0877

-Z(CODE)SWILIB_FUNC00B=A10E402C-A10E402F
-Z(CODE)SWILIB_FUNC00C=A10E4030-A10E4033
-Z(CODE)SWILIB_FUNC095=A10E4254-A10E4257
-Z(CODE)SWILIB_FUNC12B_12D=A10E44AC-A10E44B7
-Z(CODE)SWILIB_FUNC171=A10E45C4-A10E45C7
-Z(CODE)SWILIB_FUNC172=A10E45C8-A10E45CB
-Z(CODE)SWILIB_FUNC19C=A10E4670-A10E4673
-Z(CODE)SWILIB_FUNC1B8_1BB=A10E46E0-A10E46EF
-Z(CODE)SWILIB_FUNC1E9=A10E47A4-A10E47A7

-Z(DATA)REGEXPL_CNT=A84BCC88-A84BCC8B
-Z(CODE)REG_FILE=A02A0E6C-A02A0EC3

-Z(CODE)PATCH_GET_EXT=A02A0844-A02A0847
-Z(CODE)PATCH_GET_REGEXT1=A02A0654-A02A0657
-Z(CODE)PATCH_GET_REGEXT2=A02A0668-A02A066B
-Z(CODE)PATCH_BIG_ICON=A034B9F8-A034B9FB
-Z(CODE)PATCH_REGEXPL=A02A0F54-A02A0F57

-Z(CODE)PATCH_GET_PIT=A07B0FA4-A07B0FA7
-Z(CODE)PATCH_GET_PITJ=A07B0FA8-A07B0FAB

-Z(CODE)PATCH_KEYB_MSG=A07A5EB8-A07A5EBB
-Z(CODE)PATCH_KEYB_MSGJ=A07A5EBC-A07A5EBF

-Z(CODE)FSWI_PATCH1=A00929B0-A00929B3	//000002A4+A13A10D0
-Z(CODE)FSWI_PATCH2=A0092A94-A0092A97	//000001B8+A13A10D0
-Z(CODE)FSWI_PATCH3=A0092A93-A0092A94
-Z(CODE)LIBR=A10E4000-A10E7FFF