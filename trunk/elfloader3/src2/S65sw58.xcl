-carm
-Z(CODE)START,CODE,SWITAB,INITTAB,DATA_ID,DATA_C,CONFIG_DATA_ID=A0FD8000-A0FDA000

-Z(DATA)CONFIG_DATA_I,DATA_N=A86891C0-A868993C

-Z(CODE)PATCH_ONCREATE=A16B7868-A16B786B
-Z(CODE)PATCH_ONCLOSE=A16B786C-A16B786F
-Z(CODE)PATCH_ESI=A1405E98-A1405E9F

-Z(CODE)PATCH_NO_UNK_EXT=A093BDD4-A093BDD7

-Z(CODE)SWILIB_FUNC00B=A0FD402C-A0FD402F
-Z(CODE)SWILIB_FUNC00C=A0FD4030-A0FD4033
-Z(CODE)SWILIB_FUNC095=A0FD4254-A0FD4257
-Z(CODE)SWILIB_FUNC12B_12D=A0FD44AC-A0FD44B7
-Z(CODE)SWILIB_FUNC171=A0FD45C4-A0FD45C7
-Z(CODE)SWILIB_FUNC172=A0FD45C8-A0FD45CB
-Z(CODE)SWILIB_FUNC19C=A0FD4670-A0FD4673
-Z(CODE)SWILIB_FUNC1B8_1BB=A0FD46E0-A0FD46EF
-Z(CODE)SWILIB_FUNC1E9=A0FD47A4-A0FD47A7

-Z(DATA)REGEXPL_CNT=A86891BC-A86891BF
-Z(CODE)REG_FILE=A093C3CC-A093C423

-Z(CODE)PATCH_GET_EXT=A093BDA4-A093BDA7
-Z(CODE)PATCH_GET_REGEXT1=A093BBB4-A093BBB7
-Z(CODE)PATCH_GET_REGEXT2=A093BBC8-A093BBCB
-Z(CODE)PATCH_BIG_ICON=A0984A24-A0984A27
-Z(CODE)PATCH_REGEXPL=A093C4B4-A093C4B7

-Z(CODE)PATCH_GET_PIT=A11599C0-A11599C3
-Z(CODE)PATCH_GET_PITJ=A11599C4-A11599C7

-Z(CODE)PATCH_KEYB_MSG=A114F104-A114F107
-Z(CODE)PATCH_KEYB_MSGJ=A114F108-A114F10B

-Z(CODE)FSWI_PATCH1=A00927C0-A00927C3	//000002A4+A13A10D0
-Z(CODE)FSWI_PATCH2=A00928A4-A00928A7	//000001B8+A13A10D0
-Z(CODE)FSWI_PATCH3=A00928A3-A00928A4
-Z(CODE)LIBR=A0FD4000-A0FD7FFF