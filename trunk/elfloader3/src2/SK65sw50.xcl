-carm
-Z(CODE)START,CODE,SWITAB,INITTAB,DATA_ID,DATA_C,CONFIG_DATA_ID=A0FD8000-A0FDA000

-Z(DATA)CONFIG_DATA_I,DATA_N=A8E37318-A8E37A94

-Z(CODE)PATCH_ONCREATE=A0451020-A0451023
-Z(CODE)PATCH_ONCLOSE=A0451024-A0451027
-Z(CODE)PATCH_ESI=A0BA55D8-A0BA55DF

-Z(CODE)PATCH_NO_UNK_EXT=A02A001C-A02A001F

-Z(CODE)SWILIB_FUNC00B=A0FD402C-A0FD402F
-Z(CODE)SWILIB_FUNC00C=A0FD4030-A0FD4033
-Z(CODE)SWILIB_FUNC095=A0FD4254-A0FD4257
-Z(CODE)SWILIB_FUNC12B_12D=A0FD44AC-A0FD44B7
-Z(CODE)SWILIB_FUNC171=A0FD45C4-A0FD45C7
-Z(CODE)SWILIB_FUNC172=A0FD45C8-A0FD45CB
-Z(CODE)SWILIB_FUNC19C=A0FD4670-A0FD4673
-Z(CODE)SWILIB_FUNC1B8_1BB=A0FD46E0-A0FD46EF
-Z(CODE)SWILIB_FUNC1E9=A0FD47A4-A0FD47A7

-Z(DATA)REGEXPL_CNT=A8E37314-A8E37317
-Z(CODE)REG_FILE=A02A0614-A02A066B

-Z(CODE)PATCH_GET_EXT=A029FFEC-A029FFEF
-Z(CODE)PATCH_GET_REGEXT1=A029FDFC-A029FDFF
-Z(CODE)PATCH_GET_REGEXT2=A029FE10-A029FE13
-Z(CODE)PATCH_BIG_ICON=A033B744-A033B747
-Z(CODE)PATCH_REGEXPL=A02A06FC-A02A06FF

-Z(CODE)PATCH_GET_PIT=A0739240-A0739243
-Z(CODE)PATCH_GET_PITJ=A0739244-A0739247

-Z(CODE)PATCH_KEYB_MSG=A072E984-A072E987
-Z(CODE)PATCH_KEYB_MSGJ=A072E988-A072E98B

-Z(CODE)FSWI_PATCH1=A0092724-A0092727
-Z(CODE)FSWI_PATCH2=A0092808-A009280B
-Z(CODE)FSWI_PATCH3=A0092807-A0092808
-Z(CODE)LIBR=A0FD4000-A0FD7FFF