-carm
-Z(CODE)START,CODE,SWITAB,INITTAB,DATA_ID,DATA_C,CONFIG_DATA_ID=A0078000-A007A000

-Z(DATA)CONFIG_DATA_I,DATA_N=A8D7ABF0-A8D7B54F

-Z(CODE)PATCH_ONCREATE=A042DF10-A042DF13
-Z(CODE)PATCH_ONCLOSE=A042DF24-A042DF27
-Z(CODE)PATCH_ESI1=A090637C-A090637F
-Z(CODE)PATCH_ESI2=A090638C-A090638F
-Z(CODE)PATCH_SHOWMSG_BLF=A065D9C8-A065D9CB
-Z(CODE)PATCH_NO_BROWSE_TXT=A054B726-A054B729

-Z(CODE)SWILIB_FUNC171=A00745C4-A00745C7
-Z(CODE)SWILIB_FUNC172=A00745C8-A00745CB
-Z(CODE)SWILIB_FUNC19C=A0074670-A0074673
-Z(CODE)SWILIB_FUNC1B8_1BB=A00746E0-A00746EF
-Z(CODE)SWILIB_FUNC1E9=A00747A4-A00747A7

-Z(CODE)PATCH_EXT2_R4R7=A04D40B6-A04D40B9     // +
-Z(CODE)PATCH_EXT2_R6R5=A04D41D0-A04D41D3     // +
-Z(CODE)PATCH_EXT2_R5R1=A04D3F1E-A04D3F21     // +
-Z(CODE)PATCH_EXT2_R5R7=A04D3E20-A04D3E23     // +
-Z(CODE)PATCH_EXT2_CLUST1=A04D40E2-A04D40E3   // +
-Z(CODE)PATCH_EXT2_CLUST2=A04D3E40-A04D3E41   // +
-Z(CODE)PATCH_EXT2_JUMPERS=A04CE9A4-A04CE9CB  // +
-Z(CODE)PATCH_EXT2_IMPL=A04D4100-A04D4115     // +


-Z(CODE)PATCH_ENABLE_ALTOPEN=A059FDCE-A059FDCF

-Z(CODE)PATCH_GET_PIT=A09756B8-A09756BB       // +
-Z(CODE)PATCH_GET_PITJ=A09756BC-A09756BF      // +

-Z(CODE)FSWI_PATCH1=A13A4870-A13A4873
-Z(CODE)FSWI_PATCH2=A13A4784-A13A4787
-Z(CODE)LIBR=A0074000-A0077FFF