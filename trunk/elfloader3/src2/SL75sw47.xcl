-carm
// SL75v47!!!

-Z(CODE)START,CODE,SWITAB,INITTAB,DATA_ID,DATA_C,CONFIG_DATA_ID=A0078000-A007A000

-Z(DATA)CONFIG_DATA_I,DATA_N=A8D7ABFC-A8D7B55B

-Z(CODE)PATCH_ONCREATE=A04324A0-A04324A3
-Z(CODE)PATCH_ONCLOSE=A04324B4-A04324B7
-Z(CODE)PATCH_ESI1=A0908218-A090821B
-Z(CODE)PATCH_ESI2=A0908228-A090822B
-Z(CODE)PATCH_SHOWMSG_BLF=A0660734-A0660737
-Z(CODE)PATCH_NO_BROWSE_TXT=A055273A-A055273F

-Z(CODE)SWILIB_FUNC171=A00745C4-A00745C7
-Z(CODE)SWILIB_FUNC172=A00745C8-A00745CB
-Z(CODE)SWILIB_FUNC19C=A0074670-A0074673
-Z(CODE)SWILIB_FUNC1B8_1BB=A00746E0-A00746EF
-Z(CODE)SWILIB_FUNC1E9=A00747A4-A00747A7

-Z(CODE)PATCH_EXT2_R4R7=A04D996A-A04D996F     // +
-Z(CODE)PATCH_EXT2_R6R5=A04D9a84-A04D9a87     // +
-Z(CODE)PATCH_EXT2_R5R1=A04D97d2-A04D97d5     // +
-Z(CODE)PATCH_EXT2_R5R7=A04D96d4-A04D96d7     // +
-Z(CODE)PATCH_EXT2_CLUST1=A04D9996-A04D9997   // +
-Z(CODE)PATCH_EXT2_CLUST2=A04D96f4-A04D96f5   // +
-Z(CODE)PATCH_EXT2_JUMPERS=A04d3808-A04D382F  // +
-Z(CODE)PATCH_EXT2_IMPL=A04D99b4-A04D99c9    //+


-Z(CODE)PATCH_ENABLE_ALTOPEN=A05A2E56-A05A2E57

-Z(CODE)PATCH_GET_PIT=A09780a4-A09780a7       // +
-Z(CODE)PATCH_GET_PITJ=A09780a8-A09780aB      // +

-Z(CODE)FSWI_PATCH1=A13A2ADC-A13A2ADF
-Z(CODE)FSWI_PATCH2=A13A29F0-A13A29F3
-Z(CODE)LIBR=A0074000-A0077FFF